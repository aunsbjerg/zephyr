## boards/arm/frdm_kl26z/Kconfig.board
```kconfig
# FRDM-KL26Z board

# Copyright (c) 2020, Prevas A/S
# SPDX-License-Identifier: Apache-2.0

config BOARD_FRDM_KL26Z
	bool "NXP FRDM-KL26Z"
	depends on SOC_SERIES_KINETIS_KL2X
	select SOC_PART_NUMBER_MKL26Z128VLH4
```

## boards/arm/teensy_lc/Kconfig.board
```kconfig
# FRDM-KL26Z board

# Copyright (c) 2020, Prevas A/S
# SPDX-License-Identifier: Apache-2.0

config BOARD_TEENSY_LC
	bool "Teensy LC"
	depends on SOC_SERIES_KINETIS_KL2X
	select SOC_PART_NUMBER_MKL26Z64VFT4
```

## soc/arm/nxp_kinetis/kl2x/Kconfig.defconfig.mkl26z4
```kconfig
# Kinetis KL2x SoC configuration options

# Copyright (c) 2020, Prevas A/S
# SPDX-License-Identifier: Apache-2.0

if SOC_MKL26Z4

config SOC
	default "mkl26z4"

config NUM_IRQS
	default 32

config ADC_MCUX_ADC16
	default y
	depends on ADC

config CLOCK_CONTROL_MCUX_SIM
	default y
	depends on CLOCK_CONTROL

config PINMUX_MCUX
	default y
	depends on PINMUX

config GPIO_MCUX
	default y
	depends on GPIO

config UART_MCUX_LPSCI
	default y
	depends on SERIAL

config I2C_MCUX
	default y
	depends on I2C

config SOC_FLASH_MCUX
	default y
	depends on FLASH

config USB_KINETIS
	default y
	depends on USB

endif # SOC_MKL26Z
```

## soc/arm/nxp_kinetis/kl2x/Kconfig.soc
```kconfig
# Kinetis KL2x MCU series

# Copyright (c) 2017, NXP
# SPDX-License-Identifier: Apache-2.0

choice
	prompt "Kinetis KL2x MCU Selection"
	depends on SOC_SERIES_KINETIS_KL2X

config SOC_MKL25Z4
	bool "SOC_MKL25Z4"
	select CPU_CORTEX_M0PLUS
	select HAS_MCUX
	select HAS_MCUX_ADC16
	select HAS_MCUX_FTFX
	select HAS_MCUX_LPSCI
	select HAS_MCUX_SIM
	select HAS_OSC
	select HAS_MCG

config SOC_MKL26Z4
	bool "SOC_MKL26Z4"
	select CPU_CORTEX_M0PLUS
	select HAS_MCUX
	select HAS_MCUX_ADC16
	select HAS_MCUX_FTFX
	select HAS_MCUX_LPSCI
	select HAS_MCUX_SIM
	select HAS_OSC
	select HAS_MCG

endchoice

if SOC_SERIES_KINETIS_KL2X

config SOC_PART_NUMBER_MKL25Z32VFM4
	bool

config SOC_PART_NUMBER_MKL25Z64VFM4
	bool

config SOC_PART_NUMBER_MKL25Z128VFM4
	bool

config SOC_PART_NUMBER_MKL25Z32VFT4
	bool

config SOC_PART_NUMBER_MKL25Z64VFT4
	bool

config SOC_PART_NUMBER_MKL25Z128VFT4
	bool

config SOC_PART_NUMBER_MKL25Z32VLH4
	bool

config SOC_PART_NUMBER_MKL25Z64VLH4
	bool

config SOC_PART_NUMBER_MKL25Z128VLH4
	bool

config SOC_PART_NUMBER_MKL25Z32VLK4
	bool

config SOC_PART_NUMBER_MKL25Z64VLK4
	bool

config SOC_PART_NUMBER_MKL25Z128VLK4
	bool

config SOC_PART_NUMBER_MKL26Z128CAL4R
	bool

config SOC_PART_NUMBER_MKL26Z128VFM4
	bool

config SOC_PART_NUMBER_MKL26Z128VFT4
	bool

config SOC_PART_NUMBER_MKL26Z128VFT4R
	bool

config SOC_PART_NUMBER_MKL26Z128VLH4
	bool

config SOC_PART_NUMBER_MKL26Z128VLH4R
	bool

config SOC_PART_NUMBER_MKL26Z128VLL4
	bool

config SOC_PART_NUMBER_MKL26Z128VMC4
	bool

config SOC_PART_NUMBER_MKL26Z256VLH4
	bool

config SOC_PART_NUMBER_MKL26Z256VLL4
	bool

config SOC_PART_NUMBER_MKL26Z256VMC4
	bool

config SOC_PART_NUMBER_MKL26Z256VMC4R
	bool

config SOC_PART_NUMBER_MKL26Z256VMP4
	bool

config SOC_PART_NUMBER_MKL26Z32VFM4
	bool

config SOC_PART_NUMBER_MKL26Z32VFT4
	bool

config SOC_PART_NUMBER_MKL26Z32VLH4
	bool

config SOC_PART_NUMBER_MKL26Z64VFM4
	bool

config SOC_PART_NUMBER_MKL26Z64VFT4
	bool

config SOC_PART_NUMBER_MKL26Z64VFT4R
	bool

config SOC_PART_NUMBER_MKL26Z64VLH4
	bool

config SOC_PART_NUMBER_KINETIS_KL2X
	string
	default "MKL25Z32VFM4" if SOC_PART_NUMBER_MKL25Z32VFM4
	default "MKL25Z64VFM4" if SOC_PART_NUMBER_MKL25Z64VFM4
	default "MKL25Z128VFM4" if SOC_PART_NUMBER_MKL25Z128VFM4
	default "MKL25Z32VFT4" if SOC_PART_NUMBER_MKL25Z32VFT4
	default "MKL25Z64VFT4" if SOC_PART_NUMBER_MKL25Z64VFT4
	default "MKL25Z128VFT4" if SOC_PART_NUMBER_MKL25Z128VFT4
	default "MKL25Z32VLH4" if SOC_PART_NUMBER_MKL25Z32VLH4
	default "MKL25Z64VLH4" if SOC_PART_NUMBER_MKL25Z64VLH4
	default "MKL25Z128VLH4" if SOC_PART_NUMBER_MKL25Z128VLH4
	default "MKL25Z32VLK4" if SOC_PART_NUMBER_MKL25Z32VLK4
	default "MKL25Z64VLK4" if SOC_PART_NUMBER_MKL25Z64VLK4
	default "MKL25Z128VLK4" if SOC_PART_NUMBER_MKL25Z128VLK4
	default "MKL26Z128CAL4R" if SOC_PART_NUMBER_MKL26Z128CAL4R
	default "MKL26Z128VFM4" if SOC_PART_NUMBER_MKL26Z128VFM4
	default "MKL26Z128VFT4" if SOC_PART_NUMBER_MKL26Z128VFT4
	default "MKL26Z128VFT4R" if SOC_PART_NUMBER_MKL26Z128VFT4R
	default "MKL26Z128VLH4" if SOC_PART_NUMBER_MKL26Z128VLH4
	default "MKL26Z128VLH4R" if SOC_PART_NUMBER_MKL26Z128VLH4R
	default "MKL26Z128VLL4" if SOC_PART_NUMBER_MKL26Z128VLL4
	default "MKL26Z128VMC4" if SOC_PART_NUMBER_MKL26Z128VMC4
	default "MKL26Z256VLH4" if SOC_PART_NUMBER_MKL26Z256VLH4
	default "MKL26Z256VLL4" if SOC_PART_NUMBER_MKL26Z256VLL4
	default "MKL26Z256VMC4" if SOC_PART_NUMBER_MKL26Z256VMC4
	default "MKL26Z256VMC4R" if SOC_PART_NUMBER_MKL26Z256VMC4R
	default "MKL26Z256VMP4" if SOC_PART_NUMBER_MKL26Z256VMP4
	default "MKL26Z32VFM4" if SOC_PART_NUMBER_MKL26Z32VFM4
	default "MKL26Z32VFT4" if SOC_PART_NUMBER_MKL26Z32VFT4
	default "MKL26Z32VLH4" if SOC_PART_NUMBER_MKL26Z32VLH4
	default "MKL26Z64VFM4" if SOC_PART_NUMBER_MKL26Z64VFM4
	default "MKL26Z64VFT4" if SOC_PART_NUMBER_MKL26Z64VFT4
	default "MKL26Z64VFT4R" if SOC_PART_NUMBER_MKL26Z64VFT4R
	default "MKL26Z64VLH4" if SOC_PART_NUMBER_MKL26Z64VLH4
	help
	  This string holds the full part number of the SoC. It is a hidden option
	  that you should not set directly. The part number selection choice defines
	  the default value for this string.

endif # SOC_SERIES_KINETIS_KL2X
```
